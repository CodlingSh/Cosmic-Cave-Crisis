#ifndef ENEMY_H
#define ENEMY_H

// 10x16, 5 frame(s), 202 bytes
// Example: Sprites::drawPlusMask(x, y, explosion, frame);
const uint8_t PROGMEM explosion[] = {
  10, 16,
  // Frame 0
  0x00, 0x00, 0x00, 0x00, 0x00, 0x00, 0x00, 0x00, 0x30, 0x30, 0x30, 0x30,
  0x00, 0x00, 0x00, 0x00, 0x00, 0x00, 0x00, 0x00, 0x00, 0x00, 0x00, 0x00,
  0x00, 0x00, 0x00, 0x00, 0x00, 0x00, 0x00, 0x00, 0x00, 0x00, 0x00, 0x00,
  0x00, 0x00, 0x00, 0x00,
  // Frame 1
  0x00, 0x00, 0x00, 0x00, 0x00, 0x00, 0x20, 0x20, 0x38, 0x38, 0x50, 0x50,
  0x60, 0x60, 0x00, 0x00, 0x00, 0x00, 0x00, 0x00, 0x00, 0x00, 0x00, 0x00,
  0x00, 0x00, 0x00, 0x00, 0x00, 0x00, 0x00, 0x00, 0x00, 0x00, 0x00, 0x00,
  0x00, 0x00, 0x00, 0x00,
  // Frame 2
  0x00, 0x00, 0x00, 0x00, 0x30, 0x30, 0xc8, 0xc8, 0x20, 0x20, 0x94, 0x94,
  0x68, 0x68, 0x50, 0x50, 0x00, 0x00, 0x00, 0x00, 0x00, 0x00, 0x00, 0x00,
  0x00, 0x00, 0x00, 0x00, 0x00, 0x00, 0x00, 0x00, 0x00, 0x00, 0x00, 0x00,
  0x00, 0x00, 0x00, 0x00,
  // Frame 3
  0x00, 0x00, 0x20, 0x20, 0x54, 0x54, 0xaa, 0xaa, 0x58, 0x58, 0x2a, 0x2a,
  0xe0, 0xe0, 0x9c, 0x9c, 0x28, 0x28, 0x00, 0x00, 0x00, 0x00, 0x00, 0x00,
  0x00, 0x00, 0x01, 0x01, 0x00, 0x00, 0x01, 0x01, 0x00, 0x00, 0x00, 0x00,
  0x00, 0x00, 0x00, 0x00,
  // Frame 4
  0x18, 0x18, 0xa0, 0xa0, 0x04, 0x04, 0x4b, 0x4b, 0x80, 0x80, 0x0a, 0x0a,
  0x29, 0x29, 0x10, 0x10, 0x8c, 0x8c, 0x60, 0x60, 0x00, 0x00, 0x01, 0x01,
  0x00, 0x00, 0x02, 0x02, 0x02, 0x02, 0x00, 0x00, 0x03, 0x03, 0x00, 0x00,
  0x00, 0x00, 0x00, 0x00,
};

// 7x8, 1 frame(s), 16 bytes
// Example: Sprites::drawPlusMask(x, y, Nullox, frame);
const uint8_t PROGMEM nullox[] = {
  7, 8,
  0x11, 0x7f, 0x5e, 0x7f, 0x3a, 0x7f, 0x6e, 0x7f, 0x3a, 0x7f, 0x5e, 0x7f,
  0x11, 0x7f,
};

class Enemy {
  private:
    Player *player;
    int16_t x = 200;
    uint8_t y = 100;
    uint8_t width = 7;
    uint8_t height = 8;
    const uint8_t *spr = nullox;
    uint8_t highest = 0;
    uint8_t lowest = 0;
    bool active = false;
    bool moving = false;
    bool dying = false;
    int8_t deathTimer = 0;
    int8_t dir = 1;

  public:
    Enemy(Player *plyPtr) : player(plyPtr) {}

    bool isActive() {
      return active;
    }

    int16_t getX() {
      return x;
    }

    uint8_t getY() {
      return y;
    }

    uint8_t getHighest() {
      return highest;
    }

    uint8_t getLowest() {
      return lowest;
    }

    uint8_t isMoving() {
      return moving;
    }

    bool isDying() {
      return dying;
    }

    int8_t getDir() {
      return dir;
    }

    void setX(int16_t newX) {
      x = newX;
    }

    void setY(uint8_t newY) {
      y = newY;
    }

    void setHighest(uint8_t newH) {
      highest = newH;
    }

    void setLowest(uint8_t newL) {
      lowest = newL;
    }

    void setActive(bool isActive) {
      active = isActive;
    }

    uint8_t getWidth() {
      return width;
    }

    uint8_t getHeight() {
      return height;
    }

    void die() {
      dying = true;
      moving = false;
    }

    void spawn(uint8_t newH, uint8_t newL, uint8_t newX) {
      x = newX;
      y = random(newH + 5, newL - height - 5);
      highest = newH;
      lowest = newL;
      active = true;
      moving = false;
      dir = -1;
    }

    void update() {
      if (!active) {
        return;
      }

      if (x <= -10) {
        die();
      }

      if (x <= 55 && !moving && !dying) {
        if (moving == false) {
          if (player->getY() > y) {
            dir = 1;
          }
          moving = true;
        }
      }

      if (moving) {
        if (y <= highest) {
          dir = 1;
        } 
        
        if (y + height >= lowest) {
          dir = -1;
        }

        y += dir;
      }

      if (dying) {
        deathTimer++;

        if (deathTimer >= 10) {
          setX(222);
          setY(222);
          dying = false;
          active = false;
          deathTimer = 0;
        }
      }
    }

    void draw() {
      if (!active) {
        return;
      }

      if (dying) {
        Sprites::drawPlusMask(x, y, explosion, deathTimer / 2);  
      } else {
        Sprites::drawPlusMask(x, y, spr, 0);
      }

          
    }
};

#endif