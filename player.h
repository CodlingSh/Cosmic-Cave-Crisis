#ifndef PLAYER_H
#define PLAYER_H

#include <Arduboy2.h>
#include "bullet.h"

// 8x8, 1 frame(s), 18 bytes
// Example: Sprites::drawPlusMask(x, y, ship, frame);
const uint8_t PROGMEM ship[] = {
  8, 8,
  0x49, 0x49, 0x6b, 0x6b, 0x7f, 0x7f, 0x6b, 0x7f, 0x22, 0x3e, 0x36, 0x3e,
  0x1c, 0x1c, 0x08, 0x08,
};

// 10x16, 5 frame(s), 202 bytes
// Example: Sprites::drawPlusMask(x, y, explosion, frame);
const uint8_t PROGMEM shipExp[] = {
  10, 16,
  // Frame 0
  0x00, 0x00, 0x00, 0x00, 0x00, 0x00, 0x00, 0x00, 0x30, 0x30, 0x30, 0x30,
  0x00, 0x00, 0x00, 0x00, 0x00, 0x00, 0x00, 0x00, 0x00, 0x00, 0x00, 0x00,
  0x00, 0x00, 0x00, 0x00, 0x00, 0x00, 0x00, 0x00, 0x00, 0x00, 0x00, 0x00,
  0x00, 0x00, 0x00, 0x00,
  // Frame 1
  0x00, 0x00, 0x00, 0x00, 0x00, 0x00, 0x20, 0x20, 0x38, 0x38, 0x50, 0x50,
  0x60, 0x60, 0x00, 0x00, 0x00, 0x00, 0x00, 0x00, 0x00, 0x00, 0x00, 0x00,
  0x00, 0x00, 0x00, 0x00, 0x00, 0x00, 0x00, 0x00, 0x00, 0x00, 0x00, 0x00,
  0x00, 0x00, 0x00, 0x00,
  // Frame 2
  0x00, 0x00, 0x00, 0x00, 0x30, 0x30, 0xc8, 0xc8, 0x20, 0x20, 0x94, 0x94,
  0x68, 0x68, 0x50, 0x50, 0x00, 0x00, 0x00, 0x00, 0x00, 0x00, 0x00, 0x00,
  0x00, 0x00, 0x00, 0x00, 0x00, 0x00, 0x00, 0x00, 0x00, 0x00, 0x00, 0x00,
  0x00, 0x00, 0x00, 0x00,
  // Frame 3
  0x00, 0x00, 0x20, 0x20, 0x54, 0x54, 0xaa, 0xaa, 0x58, 0x58, 0x2a, 0x2a,
  0xe0, 0xe0, 0x9c, 0x9c, 0x28, 0x28, 0x00, 0x00, 0x00, 0x00, 0x00, 0x00,
  0x00, 0x00, 0x01, 0x01, 0x00, 0x00, 0x01, 0x01, 0x00, 0x00, 0x00, 0x00,
  0x00, 0x00, 0x00, 0x00,
  // Frame 4
  0x18, 0x18, 0xa0, 0xa0, 0x04, 0x04, 0x4b, 0x4b, 0x80, 0x80, 0x0a, 0x0a,
  0x29, 0x29, 0x10, 0x10, 0x8c, 0x8c, 0x60, 0x60, 0x00, 0x00, 0x01, 0x01,
  0x00, 0x00, 0x02, 0x02, 0x02, 0x02, 0x00, 0x00, 0x03, 0x03, 0x00, 0x00,
  0x00, 0x00, 0x00, 0x00,
};

class Player {
  private:
    Arduboy2 *ab;
    uint8_t *spr = ship;
    int8_t x = 10;
    int8_t y = 28;
    int16_t subY = 448;
    int8_t vel = 0;
    int8_t maxVel = 16;
    int8_t acc = 0;
    Bullet bullet;
    bool bulletActive = false;
    bool dying = false;
    int8_t deathTimer = 0;
    bool moving = true;
    
  public:
    Player(Arduboy2 *ab_ptr) : ab(ab_ptr), bullet(ab_ptr) {}

    Bullet& getBullet() {
      return bullet;
    }

    uint8_t getX() {
      return x;
    }

    uint8_t getY() {
      return y;
    }

    bool isDying() {
      return dying;
    }

    void die() {
      dying = true;
      moving = false;
      spr = shipExp;        
    }

    void fire() {
      if (!bullet.getActive()) {
        bullet.setX(x + 5);
        bullet.setY(y + 3);
        bullet.activate();
      }
    }

    void update() {
      bullet.update();

      if (dying) {
        deathTimer++;

        if (deathTimer >= 20) {
          x = 222;
          y = 222;
        }

        return;
      }

      if (!moving) {
        return;
      }

      // Movement
      if (ab->pressed(UP_BUTTON)) {
        acc = -4;
      }
      if (ab->notPressed(UP_BUTTON) && ab->notPressed(DOWN_BUTTON)) {
        acc = 0;
        vel = 0;
      }
      
      
      if (ab->pressed(DOWN_BUTTON)) {
        acc = 4;
      } 

      vel += acc;

      if (vel > maxVel) {
        subY += maxVel;
      } else if (vel < (maxVel * -1)) {
        subY += (maxVel * -1);
      } else {
        subY += vel;
      }

      if (vel > maxVel) {
        vel = maxVel;
      } else if (vel < -maxVel) {
        vel = -maxVel;
      }

      y = subY / 16;

      

      // Shooting
      if (ab->pressed(A_BUTTON)) {
        fire();
      }
    }

    void draw() {
      if (dying) {
        Sprites::drawPlusMask(x, y, spr, deathTimer / 4);
      } else {
        Sprites::drawPlusMask(x, y, spr, 0);
      }

      
      bullet.draw();
    }
};

#endif